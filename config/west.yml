## config/west.yml
```yaml
# manifest:
#   remotes:
#     - name: zmkfirmware
#       url-base: https://github.com/petejohanson
#     - name: inorichi
#       url-base: https://github.com/inorichi
#   projects:
#     - name: zmk
#       remote: zmkfirmware
#       revision: feat/pointers-move-scroll
#       import: app/west.yml
#     - name: zmk-pmw3610-driver
#       remote: inorichi
#       revision: main
#   self:
#     path: config

#defaultの設定
manifest:
  remotes:
    - name: zmkfirmware
      url-base: https://github.com/zmkfirmware
    - name: inorichi
      url-base: https://github.com/inorichi
    - name: caksoylar
      url-base: https://github.com/caksoylar
  projects:
    - name: zmk
      remote: zmkfirmware
      revision: main
      import: app/west.yml
    - name: zmk-pmw3610-driver
      remote: inorichi
      revision: main
    - name: zmk-rgbled-widget
      remote: caksoylar
      revision: main
  self:
    path: config

  # manifest:
  # remotes:
  #   - name: ImSota
  #     url-base: https://github.com/ImSota
  #   - name: inorichi
  #     url-base: https://github.com/inorichi
  #   - name: caksoylar
  #     url-base: https://github.com/caksoylar
  # projects:
  #   - name: zmk
  #     remote: ImSota
  #     revision: main
  #     import: app/west.yml
  #   - name: zmk-pmw3610-driver
  #     remote: inorichi
  #     revision: main
  #   - name: zmk-rgbled-widget
  #     remote: caksoylar
  #     revision: main
  # self:
  #   path: config
manifest:
  remotes:
    - name: zmkfirmware
      url-base: https://github.com/zmkfirmware
    - name: prospector
      url-base: https://github.com/t-ogura
  projects:
    - name: zmk
      remote: zmkfirmware
      revision: main
      import: app/west.yml
    - name: prospector-zmk-module
      remote: prospector
      revision: v1.0.0
      path: modules/prospector-zmk-module
```
